## CMakeLists.txt
```
# CMake documentation: https://cmake.org/cmake/help/latest/index.html
# Specify the minimum required CMake version
cmake_minimum_required(VERSION 3.20.0)

# Set the shields to use
set(SHIELD waveshare_rgb_led_hat)

# Find the Zephyr package
find_package(Zephyr REQUIRED HINTS $ENV{ZEPHYR_BASE})

# Set the project name
project(rgb_led_hat
        VERSION 1.0.0
        DESCRIPTION "RGB LED Hat Application"
        HOMEPAGE_URL "https://github.com/pizero-zephyr/pizero-zephyr"
)

# Add the source files
target_sources(app PRIVATE src/main.c)

# Example
# Add a library
# add_library(my_library STATIC src/my_library.c)

# Set the include directories for the library. PUBLIC adds the directory
# to the search path for any targets that link to this library.
# target_include_directories(my_library PUBLIC include)
# target_include_directories(my_library PUBLIC ${CMAKE_CURRENT_SOURCE_DIR}/include)

# target_link_libraries(my_library PUBLIC other_library)
```

## prj.conf
```kconfig
CONFIG_USB_DEVICE_STACK_NEXT=y

CONFIG_SERIAL=y
CONFIG_CONSOLE=y
CONFIG_UART_CONSOLE=y
CONFIG_UART_LINE_CTRL=y

CONFIG_PRINTK=y

CONFIG_CDC_ACM_SERIAL_INITIALIZE_AT_BOOT=y

CONFIG_LED_STRIP=y
```

## src/main.c
```c
#include <zephyr/kernel.h>
#include <zephyr/sys/printk.h>
#include <zephyr/device.h>
#include <zephyr/drivers/led_strip.h>

#define STRIP_NODE DT_ALIAS(led_strip)

#if !DT_NODE_HAS_STATUS(STRIP_NODE, okay)
#error "LED strip device is not enabled"
#endif

#define NUM_PIXELS DT_PROP(STRIP_NODE, chain_length)

static const struct device *strip = DEVICE_DT_GET(STRIP_NODE);

static struct led_rgb pixels[NUM_PIXELS];

static int set_color(uint8_t r, uint8_t g, uint8_t b)
{
    for (int i = 0; i < NUM_PIXELS; i++) {
        pixels[i].r = r;
        pixels[i].g = g;
        pixels[i].b = b;
    }

    return led_strip_update_rgb(strip, pixels, NUM_PIXELS);
}

int main(void)
{
	int res = 0;

    printk("Hello from Waveshare PiZero RP2350!\r\n");

    printk("LED strip: %s\r\n", strip->name);
    printk("Number of pixels: %d\r\n", NUM_PIXELS);

    if (!device_is_ready(strip)) {
        printk("ERROR: LED strip device is NOT ready\r\n");
        return 0;
    }

    printk("LED strip device is ready\r\n");

    while (1) {

        printk("RED\r\n");
        res = set_color(0x05, 0x00, 0x00);
        if (res < 0) {
            printk("ERROR: Failed to set color\r\n");
        }
        k_sleep(K_SECONDS(2));

        printk("GREEN\r\n");
        res = set_color(0x00, 0x05, 0x00);
        if (res < 0) {
            printk("ERROR: Failed to set color\r\n");
        }
        k_sleep(K_SECONDS(2));

        printk("BLUE\r\n");
        res = set_color(0x00, 0x00, 0x05);
        if (res < 0) {
            printk("ERROR: Failed to set color\r\n");
        }
        k_sleep(K_SECONDS(2));

        printk("WHITE\r\n");
        res = set_color(0x05, 0x05, 0x05);
        if (res < 0) {
            printk("ERROR: Failed to set color\r\n");
        }
        k_sleep(K_SECONDS(2));

        printk("OFF\r\n");
        res = set_color(0x00, 0x00, 0x00);
        if (res < 0) {
            printk("ERROR: Failed to set color\r\n");
        }
        k_sleep(K_SECONDS(2));
    }

    return 0;
}
```
