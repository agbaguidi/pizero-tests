## CMakeLists.txt
```
# CMake documentation: https://cmake.org/cmake/help/latest/index.html
# Specify the minimum required CMake version
cmake_minimum_required(VERSION 3.20.0)

# Find the Zephyr package
find_package(Zephyr REQUIRED HINTS $ENV{ZEPHYR_BASE})

# Set the project name
project(hello_world
        VERSION 1.0.0
        DESCRIPTION "Hello World Application"
        HOMEPAGE_URL "https://github.com/pizero-zephyr/pizero-zephyr"
)

# Add the source files
target_sources(app PRIVATE src/main.c)

# Example
# Add a library
# add_library(my_library STATIC src/my_library.c)

# Set the include directories for the library. PUBLIC adds the directory
# to the search path for any targets that link to this library.
# target_include_directories(my_library PUBLIC include)
# target_include_directories(my_library PUBLIC ${CMAKE_CURRENT_SOURCE_DIR}/include)

# target_link_libraries(my_library PUBLIC other_library)
```

## prj.conf
```kconfig
CONFIG_SERIAL=y
CONFIG_CONSOLE=y
CONFIG_UART_CONSOLE=y

CONFIG_PRINTK=y
```

## src/main.c
```c
#include <zephyr/kernel.h>
#include <zephyr/device.h>
#include <zephyr/drivers/uart.h>
#include <zephyr/sys/printk.h>

int main(void)
{
    const struct device *uart = DEVICE_DT_GET(DT_NODELABEL(uart0));

    printk("Hello World\r\n");

    if (!device_is_ready(uart)) {
        printk("ERROR: UART0 is not ready\r\n");
        return 0;
    }

    printk("UART0 is ready\r\n");

    while (1) {
        const char msg[] = "Hello World\r\n";

        for (size_t i = 0; i < sizeof(msg) - 1; i++) {
            uart_poll_out(uart, msg[i]);
        }

        k_sleep(K_SECONDS(1));
    }

    return 0;
}
```
