## pizero-zephyr/boards/shields/waveshare_rgb_led_hat/Kconfig.defconfig
```kconfig
# Copyright (c) 2026 Nono
# SPDX-License-Identifier: Apache-2.0

if SHIELD_WAVESHARE_RGB_LED_HAT

config LED_STRIP
	default y

endif # SHIELD_WAVESHARE_RGB_LED_HAT
```

## pizero-zephyr/boards/shields/waveshare_rgb_led_hat/Kconfig.shield
```kconfig
# Copyright (c) 2026 Nono
# SPDX-License-Identifier: Apache-2.0

config SHIELD_WAVESHARE_RGB_LED_HAT
	def_bool $(shields_list_contains,waveshare_rgb_led_hat)
```

## pizero-zephyr/boards/waveshare/pizero_rp2350/Kconfig.defconfig
```kconfig
# Copyright (c) 2026 Nono
# SPDX-License-Identifier: Apache-2.0

if BOARD_WAVESHARE_PIZERO_RP2350

config USB_SELF_POWERED
	default n

endif # BOARD_WAVESHARE_PIZERO_RP2350
```

## pizero-zephyr/boards/waveshare/pizero_rp2350/Kconfig.waveshare_pizero_rp2350
```kconfig
# Copyright (c) 2026 Nono
# SPDX-License-Identifier: Apache-2.0

config BOARD_WAVESHARE_PIZERO_RP2350
	select SOC_RP2350B_M33 if BOARD_WAVESHARE_PIZERO_RP2350_RP2350B_M33
```

## pizero-zephyr/boards/waveshare/pizero_rp2350/board.yml
```yaml
board:
  name: waveshare_pizero_rp2350
  full_name: Waveshare RP2350-PiZero
  vendor: waveshare
  socs:
  - name: rp2350b
```
