## CMakeLists.txt
```
cmake_minimum_required(VERSION 3.20.0)

set(SHIELD waveshare_rgb_led_hat waveshare_rs485_can_hat)

find_package(Zephyr REQUIRED HINTS $ENV{ZEPHYR_BASE})

project(pizero_test)

target_sources(app PRIVATE src/main.c)
```

## prj.conf
```kconfig
CONFIG_USB_DEVICE_STACK_NEXT=y

CONFIG_SERIAL=y
CONFIG_CONSOLE=y
CONFIG_UART_CONSOLE=y
CONFIG_UART_LINE_CTRL=y

CONFIG_PRINTK=y

CONFIG_CDC_ACM_SERIAL_INITIALIZE_AT_BOOT=y
```

## boards/waveshare_pizero_rp2350_rp2350b_m33.overlay
```dts
/ {
	chosen {
		zephyr,console = &cdc_acm_uart0;
		zephyr,shell-uart = &cdc_acm_uart0;
	};
};

&zephyr_udc0 {
	cdc_acm_uart0: cdc_acm_uart0 {
		compatible = "zephyr,cdc-acm-uart";
		label = "CDC_ACM_0";
	};
};
```

## src/main.c
```c
#include <zephyr/kernel.h>
#include <zephyr/sys/printk.h>
#include <zephyr/device.h>
#include <zephyr/drivers/led_strip.h>

#define STRIP_NODE DT_ALIAS(led_strip)

#if !DT_NODE_HAS_STATUS(STRIP_NODE, okay)
#error "LED strip device is not enabled"
#endif

#define NUM_PIXELS DT_PROP(STRIP_NODE, chain_length)

static const struct device *strip = DEVICE_DT_GET(STRIP_NODE);

static struct led_rgb pixels[NUM_PIXELS];

static int set_color(uint8_t r, uint8_t g, uint8_t b)
{
    for (int i = 0; i < NUM_PIXELS; i++) {
        pixels[i].r = r;
        pixels[i].g = g;
        pixels[i].b = b;
    }

    return led_strip_update_rgb(strip, pixels, NUM_PIXELS);
}

int main(void)
{
	int res = 0;

    printk("Hello from Waveshare PiZero RP2350!\r\n");

    printk("LED strip: %s\r\n", strip->name);
    printk("Number of pixels: %d\r\n", NUM_PIXELS);

    if (!device_is_ready(strip)) {
        printk("ERROR: LED strip device is NOT ready\r\n");
        return 0;
    }

    printk("LED strip device is ready\r\n");

    while (1) {

        printk("RED\r\n");
        res = set_color(0x20, 0x00, 0x00);
        if (res < 0) {
            printk("ERROR: Failed to set color\r\n");
        }
        k_sleep(K_SECONDS(2));

        printk("GREEN\r\n");
        res = set_color(0x00, 0x20, 0x00);
        if (res < 0) {
            printk("ERROR: Failed to set color\r\n");
        }
        k_sleep(K_SECONDS(2));

        printk("BLUE\r\n");
        res = set_color(0x00, 0x00, 0x20);
        if (res < 0) {
            printk("ERROR: Failed to set color\r\n");
        }
        k_sleep(K_SECONDS(2));

        printk("WHITE\r\n");
        res = set_color(0x20, 0x20, 0x20);
        if (res < 0) {
            printk("ERROR: Failed to set color\r\n");
        }
        k_sleep(K_SECONDS(2));

        printk("OFF\r\n");
        res = set_color(0x00, 0x00, 0x00);
        if (res < 0) {
            printk("ERROR: Failed to set color\r\n");
        }
        k_sleep(K_SECONDS(2));
    }

    return 0;
}
```
